## drivers/video/msm/Kconfig
```kconfig
source "drivers/video/msm/vidc/Kconfig"
config FB_MSM
	tristate
	depends on FB && ARCH_MSM
	select FB_CFB_FILLRECT
	select FB_CFB_COPYAREA
	select FB_CFB_IMAGEBLIT
	default y

config FB_MSM_LEGACY_MDP
	bool
	depends on FB_MSM && (MSM_MDP30 || MSM_MDP31 || MSM_MDP302)
	default y

config FB_MSM_MDP_PPP
	bool
	depends on FB_MSM_LEGACY_MDP
	default y

config FB_MSM_LCDC
	bool "Support for integrated LCD controller in qsd8x50 ,MSM7x27 and MSM7x30"
	depends on FB_MSM && (MSM_MDP31 || MSM_MDP302 || MSM_MDP40)
	default y

config FB_MSM_TVOUT
	bool "Support for TV-Out in qsd8x50"
	depends on FB_MSM && (MSM_MDP31 || MSM_MDP40)
	default n

config FB_MSM_OVERLAY
	bool "Support for overlay in MSM7X30"
	depends on FB_MSM && MSM_MDP40
	default y

config FB_MSM_DTV
	depends on FB_MSM_OVERLAY
	bool
	default n

config FB_MSM_MDP_ABL
        bool "Support QCT auto backlight scaling"
        depends on FB_MSM && (MSM_MDP40)
        default n

config MSM_HDMI_COMMON
	bool "Turn on HDMI common interface"
	depends on FB_MSM_OVERLAY && MSM_MDP40
	bool
	default n

config MSM_HDMI
	bool "Support for HDMI in QCT platform"
	depends on MSM_MDP31 || MSM_MDP40
	default n

config MSM_HDMI_MHL
	bool "Turn on MHL chip driver"
	depends on FB_MSM_OVERLAY && MSM_MDP40
	bool
	default n
```
